## package/cmake-modules-webos/Config.in
```kconfig
config BR2_PACKAGE_CMAKE_MODULES_WEBOS
	bool "cmake-modules-webos"
	depends on BR2_PACKAGE_WEBOS
```

## package/glibc-polyfills/Config.in
```kconfig
config BR2_PACKAGE_GLIBC_POLYFILLS
	bool "glibc-polyfills"
	help
	  glibc compatibility layer and backports
```

## package/hyperion-webos/Config.in
```kconfig
config BR2_PACKAGE_HYPERION_WEBOS
	bool "hyperion-webos"
	depends on BR2_PACKAGE_HAS_LIBEGL && BR2_PACKAGE_HAS_LIBGLES
	select BR2_PACKAGE_PMLOGLIB
	select BR2_PACKAGE_LUNA_SERVICE2
	select BR2_PACKAGE_LIBPBNJSON

comment "hyperion-webos needs EGL and OpenGL ES support"
	depends on !BR2_PACKAGE_HAS_LIBEGL || \
		!BR2_PACKAGE_HAS_LIBGLESBR2_PACKAGE_HAS_LIBEGL_WAYLAND
```

## package/lg-gfx/Config.in
```kconfig
config BR2_PACKAGE_LG_GFX
	bool "lg-gfx"
	depends on BR2_LINUX_KERNEL && BR2_TOOLCHAIN_USES_GLIBC && BR2_arm
	select BR2_HOSTARCH_NEEDS_IA32_LIBS
	select BR2_PACKAGE_HAS_LIBEGL
	select BR2_PACKAGE_HAS_LIBGLES
	select BR2_PACKAGE_HAS_POWERVR
	select BR2_PACKAGE_FBSET if !BR2_PACKAGE_BUSYBOX # Runtime dependency only
	select BR2_LINUX_NEEDS_MODULES # not using kernel-module infra
	help
	  Graphics libraries for LG boards.

if BR2_PACKAGE_LG_GFX

config BR2_PACKAGE_PROVIDES_LIBEGL
	default "lg-gfx"

config BR2_PACKAGE_PROVIDES_LIBGLES
	default "lg-gfx"

config BR2_PACKAGE_PROVIDES_POWERVR
	default "lg-gfx"

config BR2_PACKAGE_LG_GFX_DEBUG
	bool "enable debug support"
	help
	  Turns on debugging in the kernel module, install libraries built with
	  debugging enabled, installs various tests and installs esrev script.

config BR2_PACKAGE_LG_GFX_DEMOS
	bool "install demos"
	default y
	help
	  Install the OGLES2ChameleonMan and OGLES2MagicLantern demos

config BR2_PACKAGE_LG_GFX_EGLIMAGE
	bool "install eglimage version of libraries"
	help
	  Installs OpenGL libaries which support the eglimage api.

endif

comment "lg-gfx needs an (e)glibc toolchain and a Linux kernel to be built"
	depends on BR2_arm
	depends on !(BR2_LINUX_KERNEL && BR2_TOOLCHAIN_USES_GLIBC)
```

## package/lg_alsa/Config.in
```kconfig
config BR2_PACKAGE_LG_ALSA
	bool "lg_alsa"
	depends on BR2_LINUX_KERNEL
	help
		LG Custom ALSA glue
```

## package/lgtv/Config.in
```kconfig
config BR2_PACKAGE_LGTV
	bool "lgtv"
	depends on BR2_INSTALL_LIBSTDCPP
	depends on BR2_TOOLCHAIN_HAS_THREADS
	select BR2_PACKAGE_GLIBC_POLYFILLS
	help
	  LGTV meta-package
```

## package/libcapstone/Config.in
```kconfig
config BR2_PACKAGE_LIBCAPSTONE
	bool "libcapstone"

if BR2_PACKAGE_LIBCAPSTONE

menu "Architectures"

config BR2_PACKAGE_LIBCAPSTONE_ARM
	bool "ARM support"

config BR2_PACKAGE_LIBCAPSTONE_ARM64
	bool "ARM64 support"

config BR2_PACKAGE_LIBCAPSTONE_M680X
	bool "M680X support"

config BR2_PACKAGE_LIBCAPSTONE_M68K
	bool "M68K support"

config BR2_PACKAGE_LIBCAPSTONE_MIPS
	bool "MIPS support"

config BR2_PACKAGE_LIBCAPSTONE_MOS65XX
	bool "MOS65XX support"

config BR2_PACKAGE_LIBCAPSTONE_PPC
	bool "PPC support"

config BR2_PACKAGE_LIBCAPSTONE_SPARC
	bool "SPARC support"

config BR2_PACKAGE_LIBCAPSTONE_SYSZ
	bool "SystemZ support"

config BR2_PACKAGE_LIBCAPSTONE_XCORE
	bool "XCORE support"

config BR2_PACKAGE_LIBCAPSTONE_X86
	bool "X86 support"

config BR2_PACKAGE_LIBCAPSTONE_TMS320C64X
	bool "TMS320C64X support"

config BR2_PACKAGE_LIBCAPSTONE_EVM
	bool "EVM support"

endmenu # Architectures

config BR2_PACKAGE_LIBCAPSTONE_DIET
	bool "Diet mode"

endif # BR2_PACKAGE_LIBCAPSTONE
```

## package/libfrida-gum/Config.in
```kconfig
config BR2_PACKAGE_LIBFRIDA_GUM
	bool "libfrida-gum"
	select BR2_PACKAGE_LIBGLIB2
	select BR2_PACKAGE_LIBUNWIND
	select BR2_PACKAGE_LIBFFI
	select BR2_PACKAGE_LIBCAPSTONE
	select BR2_PACKAGE_LIBDWARF

if BR2_PACKAGE_LIBFRIDA_GUM

config BR2_PACKAGE_LIBFRIDA_GUM_DIET
	bool "Diet mode"

endif # BR2_PACKAGE_LIBCAPSTONE
```

## package/libpbnjson/Config.in
```kconfig
config BR2_PACKAGE_LIBPBNJSON
	bool "libpbnjson"
	select BR2_PACKAGE_CMAKE_MODULES_WEBOS
	select BR2_PACKAGE_BOOST
	select BR2_PACKAGE_BOOST_PROGRAM_OPTIONS
	select BR2_PACKAGE_GMP
	select BR2_PACKAGE_LIBGLIB2
	select BR2_PACKAGE_LIBURIPARSER
	select BR2_PACKAGE_YAJL
```

## package/libwebosi18n/Config.in
```kconfig
config BR2_PACKAGE_LIBWEBOSI18N
	bool "libwebosi18n"
	select BR2_PACKAGE_CMAKE_MODULES_WEBOS
	select BR2_PACKAGE_LIBPBNJSON
	select BR2_PACKAGE_BOOST
	select BR2_PACKAGE_BOOST_REGEX
```

## package/luna-service2/Config.in
```kconfig
config BR2_PACKAGE_LUNA_SERVICE2
	bool "luna-service2"
	select BR2_PACKAGE_CMAKE_MODULES_WEBOS
	select BR2_PACKAGE_LIBGLIB2
	select BR2_PACKAGE_LIBPBNJSON
	select BR2_PACKAGE_PMLOGLIB
```

## package/moonlight-tv/Config.in
```kconfig
config BR2_PACKAGE_MOONLIGHT_TV
	bool "moonlight-tv"
	depends on BR2_PACKAGE_HAS_LIBEGL && BR2_PACKAGE_HAS_LIBGLES
	select BR2_PACKAGE_SDL2
	select BR2_PACKAGE_SDL2_IMAGE
	select BR2_PACKAGE_LIBCURL
	select BR2_PACKAGE_EXPAT
	select BR2_PACKAGE_FONTCONFIG
	select BR2_PACKAGE_FREETYPE
	select BR2_PACKAGE_LIBPBNJSON
	select BR2_PACKAGE_LIBWEBOSI18N
	select BR2_PACKAGE_PMLOGLIB
	select BR2_PACKAGE_JSON_C
	select BR2_PACKAGE_PULSEAUDIO
	select BR2_PACKAGE_UMEDIASERVER
        select BR2_PACKAGE_SDL2_WEBOS

comment "moonlight-tv needs EGL and OpenGL ES support"
	depends on !BR2_PACKAGE_HAS_LIBEGL || \
		!BR2_PACKAGE_HAS_LIBGLESBR2_PACKAGE_HAS_LIBEGL_WAYLAND
```

## package/php-openswoole/Config.in
```kconfig
config BR2_PACKAGE_PHP_OPENSWOOLE
	bool "php-openswoole"
	help
	  Programmatic server for PHP with async IO, coroutines and fibers 

	  https://openswoole.com/
```

## package/pmloglib/Config.in
```kconfig
config BR2_PACKAGE_PMLOGLIB
	bool "pmloglib"
	depends on BR2_PACKAGE_WEBOS
	select BR2_PACKAGE_CMAKE_MODULES_WEBOS
	select BR2_PACKAGE_LIBGLIB2
	select BR2_PACKAGE_LIBPBNJSON
```

## package/sdl2_tests/Config.in
```kconfig
config BR2_PACKAGE_SDL2_TESTS
	bool "sdl2 tests"
	depends on !BR2_STATIC_LIBS && BR2_PACKAGE_SDL2
	help
	  Simple DirectMedia Layer 2 - SDL2 is a library that allows
	  programs portable low level access to a video framebuffer,
	  audio output, mouse, and keyboard. It is not compatible with
	  SDL1.

	  http://www.libsdl.org/

if BR2_PACKAGE_SDL2_TESTS
endif

comment "sdl2_tests needs sdl2"
	depends on !BR2_PACKAGE_SDL2
```

## package/sdlmame/Config.in
```kconfig
config BR2_PACKAGE_SDLMAME
	bool "sdlmame"
	depends on BR2_PACKAGE_SDL2 && BR2_PACKAGE_SDL2_TTF
	help
		SDL Mame
```

## package/terminate/Config.in
```kconfig
config BR2_PACKAGE_TERMINATE
	bool "terminate"
	depends on BR2_PACKAGE_SDL2 && BR2_PACKAGE_SDL2_TTF
	help
		SDL Terminal Emulator
```

## package/umediaserver/Config.in
```kconfig
config BR2_PACKAGE_UMEDIASERVER
	bool "umediaserver"
	select BR2_PACKAGE_CMAKE_MODULES_WEBOS
	select BR2_PACKAGE_LIBPBNJSON
	select BR2_PACKAGE_LIBCONFIG
	select BR2_PACKAGE_BOOST
	select BR2_PACKAGE_BOOST_REGEX
	select BR2_PACKAGE_BOOST_FILESYSTEM
	select BR2_PACKAGE_LUNA_SERVICE2
	select BR2_PACKAGE_GSTREAMER1
	select BR2_PACKAGE_GST1_PLUGINS_BASE
	select BR2_PACKAGE_SQLITE
	select BR2_PACKAGE_PYTHON
```

## package/webos-gmp/Config.in
```kconfig
config BR2_PACKAGE_WEBOS_GMP
	bool "gmp 4.2.1 (shared only)"
	depends on BR2_WEBOS_COMPAT
	depends on BR2_PACKAGE_GMP
	help
	  The version of GMP used on webOS (up through at least
	  webOS 8).

	  This replaces the normal buildroot GMP on the target (but not
	  host, which continues to use a modern version).
```

## package/webos-gnutls/Config.in
```kconfig
config BR2_PACKAGE_WEBOS_GNUTLS
	bool "gnutls 3.3.30"
	depends on BR2_WEBOS_COMPAT
	depends on BR2_PACKAGE_GNUTLS
	help
	  The version of gnutls used on webOS 5-8. It should be compatible
	  back to webOS 3.x in theory.

	  webOS 1, 2: 2.12.23 (libgnutls.so.26)
	  webOS 3.x: 3.3.5 (libgnutls.so.28)
	  webOS 4.x: 3.3.27 (libgnutls.so.28)
	  webOS 5-8: 3.3.30 (libgnutls.so.28)

	  This replaces the normal buildroot gnutls on the target (but
	  not host).
```

## package/webos-userland/Config.in
```kconfig
config BR2_PACKAGE_WEBOS_USERLAND
	bool "webos-userland"
	depends on BR2_INSTALL_LIBSTDCPP
	depends on BR2_TOOLCHAIN_HAS_THREADS
	depends on !BR2_STATIC_LIBS
	depends on BR2_PACKAGE_WEBOS
	select BR2_PACKAGE_HAS_LIBEGL
	select BR2_PACKAGE_HAS_LIBGLES
	select BR2_PACKAGE_HAS_LIBEGL_WAYLAND
	help
	  Webos Userland contains the necessary stub libraries to link
	  against.

	  Includes source for the ARM side code to interface to: EGL,
	  GLESv1_cm, GLESv2, wayland-egl.

if BR2_PACKAGE_WEBOS_USERLAND

config BR2_PACKAGE_PROVIDES_LIBEGL
	default "webos-userland"

config BR2_PACKAGE_PROVIDES_LIBGLES
	default "webos-userland"

endif


choice
	prompt "libwayland-egl SONAME"
	default BR2_WAYLAND_EGL_SOVERSION_NONE if BR2_arm
	default BR2_WAYLAND_EGL_SOVERSION_1 if BR2_i386
	depends on BR2_PACKAGE_WEBOS_USERLAND && BR2_PACKAGE_HAS_LIBEGL_WAYLAND
	help
	  Select the SOVERSION of libwayland-egl.so you wish to use.

config BR2_WAYLAND_EGL_SOVERSION_NONE
	bool "libwayland-egl.so"

config BR2_WAYLAND_EGL_SOVERSION_1
	bool "libwayland-egl.so.1"

endchoice

comment "webos-userland needs a toolchain w/ C++, threads, dynamic library"
	depends on !BR2_INSTALL_LIBSTDCPP || !BR2_TOOLCHAIN_HAS_THREADS || \
		BR2_STATIC_LIBS
```

## package/webos-wayland-extensions/Config.in
```kconfig
config BR2_PACKAGE_WEBOS_WAYLAND_EXTENSIONS
	bool "webos-wayland-extensions"
	depends on BR2_PACKAGE_WEBOS
	depends on BR2_PACKAGE_WAYLAND
	select BR2_PACKAGE_CMAKE_MODULES_WEBOS
```

## package/webos/Config.in
```kconfig
config BR2_PACKAGE_WEBOS
	bool "webos"
	depends on BR2_INSTALL_LIBSTDCPP
	depends on BR2_TOOLCHAIN_HAS_THREADS
	depends on BR2_PACKAGE_LGTV
	help
	  WebOS meta-package

config BR2_WEBOS_COMPAT
	bool "webOS compat"
	depends on BR2_PACKAGE_WEBOS
	help
	  Use old versions of certain packages on the target in an
	  attempt to be more compatible with webOS.
```
